## klippercomparison/UPDATED COMPARISON/CanBoot/src/Kconfig.txt
```kconfig
Differences in src/Kconfig:

- Lines with differences: 7 lines in 3 blocks

Detailed Differences:

--- /media/mks/5dcae443-0796-4029-ae6c-bf5bd2a37067/home/mks/CanBoot/src/Kconfig	2023-08-12 06:18:51.900709110 -0400
+++ /home/mks/firmware_comparison/downloads/CanBoot/src/Kconfig	2024-10-08 17:45:28.585223681 -0400
@@ -1,6 +1,6 @@
 # Main Kconfig settings
 
-VERSION := $(shell, git describe --tags --long --always --dirty 2> /dev/null)
+VERSION := $(shell, ./scripts/make-version.sh 2> /dev/null)
 
 mainmenu "Katapult Configuration $(VERSION)"
 
@@ -73,7 +73,7 @@
     default y if CANSERIAL || USBCANBUS
 config CANBUS_FREQUENCY
     int "CAN bus speed" if LOW_LEVEL_OPTIONS && CANBUS
-    default 500000
+    default 1000000
 config CANBUS_FILTER
     bool
     default y if CANSERIAL
@@ -120,3 +120,7 @@
 config HAVE_CHIPID
     bool
     default n
+
+config KATAPULT_VERSION
+    string
+    default "$(VERSION)"
```

## klippercomparison/UPDATED COMPARISON/CanBoot/src/stm32/Kconfig.txt
```kconfig
Differences in src/stm32/Kconfig:

- Lines with differences: 8 lines in 2 blocks

Detailed Differences:

--- /media/mks/5dcae443-0796-4029-ae6c-bf5bd2a37067/home/mks/CanBoot/src/stm32/Kconfig	2023-08-12 06:18:51.924709110 -0400
+++ /home/mks/firmware_comparison/downloads/CanBoot/src/stm32/Kconfig	2024-10-08 17:45:28.589223696 -0400
@@ -388,11 +388,11 @@
         select CANSERIAL
     config STM32_MMENU_CANBUS_PB5_PB6
         bool "CAN bus (on PB5/PB6)" if LOW_LEVEL_OPTIONS
-        depends on HAVE_STM32_CANBUS && MACH_STM32F4
+        depends on (HAVE_STM32_CANBUS && MACH_STM32F4) || (HAVE_STM32_FDCANBUS && MACH_STM32G0B1)
         select CANSERIAL
     config STM32_MMENU_CANBUS_PB12_PB13
         bool "CAN bus (on PB12/PB13)" if LOW_LEVEL_OPTIONS
-        depends on HAVE_STM32_CANBUS && MACH_STM32F4
+        depends on (HAVE_STM32_CANBUS && MACH_STM32F4) || HAVE_STM32_FDCANBUS
         select CANSERIAL
     config STM32_MMENU_CANBUS_PD0_PD1
         bool "CAN bus (on PD0/PD1)" if LOW_LEVEL_OPTIONS
@@ -424,10 +424,10 @@
         depends on HAVE_STM32_CANBUS && MACH_STM32F4
     config STM32_CMENU_CANBUS_PB5_PB6
         bool "CAN bus (on PB5/PB6)"
-        depends on HAVE_STM32_CANBUS && MACH_STM32F4
+        depends on (HAVE_STM32_CANBUS && MACH_STM32F4) || (HAVE_STM32_FDCANBUS && MACH_STM32G0B1)
     config STM32_CMENU_CANBUS_PB12_PB13
         bool "CAN bus (on PB12/PB13)"
-        depends on HAVE_STM32_CANBUS && MACH_STM32F4
+        depends on (HAVE_STM32_CANBUS && MACH_STM32F4) || HAVE_STM32_FDCANBUS
     config STM32_CMENU_CANBUS_PD0_PD1
         bool "CAN bus (on PD0/PD1)"
         depends on HAVE_STM32_CANBUS || HAVE_STM32_FDCANBUS
```

## klippercomparison/UPDATED COMPARISON/klipper/src/avr/Kconfig.txt
```kconfig
Differences in src/avr/Kconfig:

- Lines with differences: 2 lines in 1 blocks

Detailed Differences:

--- /media/mks/5dcae443-0796-4029-ae6c-bf5bd2a37067/home/mks/klipper/src/avr/Kconfig	2023-10-20 03:52:19.584163937 -0400
+++ /home/mks/firmware_comparison/downloads/klipper/src/avr/Kconfig	2024-10-08 17:45:26.888217467 -0400
@@ -11,7 +11,7 @@
     select HAVE_GPIO_I2C
     select HAVE_GPIO_HARD_PWM
     select HAVE_STRICT_TIMING
-    select HAVE_LIMITED_CODE_SIZE if MACH_atmega168
+    select HAVE_LIMITED_CODE_SIZE if MACH_atmega168 || MACH_atmega328 || MACH_atmega328p || MACH_atmega32u4
 
 config BOARD_DIRECTORY
     string
```

## klippercomparison/clean comparisons/klipper/src/Kconfig.txt
```kconfig
Differences in src/Kconfig:

- Lines with differences: 26 lines in 3 blocks

Detailed Differences:

--- /media/mks/5dcae443-0796-4029-ae6c-bf5bd2a37067/home/mks/klipper/src/Kconfig	2023-10-20 03:52:19.564163937 -0400
+++ /home/mks/firmware_comparison/downloads/klipper/src/Kconfig	2024-10-08 17:45:26.888217467 -0400
@@ -104,6 +104,18 @@
     bool
     depends on HAVE_GPIO_SPI
     default y
+config WANT_LDC1612
+    bool
+    depends on HAVE_GPIO_I2C
+    default y
+config WANT_HX71X
+    bool
+    depends on WANT_GPIO_BITBANGING
+    default y
+config WANT_ADS1220
+    bool
+    depends on HAVE_GPIO_SPI
+    default y
 config WANT_SOFTWARE_I2C
     bool
     depends on HAVE_GPIO && HAVE_GPIO_I2C
@@ -112,6 +124,11 @@
     bool
     depends on HAVE_GPIO && HAVE_GPIO_SPI
     default y
+config NEED_SENSOR_BULK
+    bool
+    depends on WANT_SENSORS || WANT_LIS2DW || WANT_LDC1612 || WANT_HX71X \
+        || WANT_ADS1220
+    default y
 menu "Optional features (to reduce code size)"
     depends on HAVE_LIMITED_CODE_SIZE
 config WANT_GPIO_BITBANGING
@@ -126,6 +143,15 @@
 config WANT_LIS2DW
     bool "Support lis2dw 3-axis accelerometer"
     depends on HAVE_GPIO_SPI
+config WANT_LDC1612
+    bool "Support ldc1612 eddy current sensor"
+    depends on HAVE_GPIO_I2C
+config WANT_HX71X
+    bool "Support HX711 and HX717 ADC chips"
+    depends on WANT_GPIO_BITBANGING
+config WANT_ADS1220
+    bool "Support ADS 1220 ADC chip"
+    depends on HAVE_GPIO_SPI
 config WANT_SOFTWARE_I2C
     bool "Support software based I2C \"bit-banging\""
     depends on HAVE_GPIO && HAVE_GPIO_I2C
```

## klippercomparison/clean comparisons/klipper/src/rp2040/Kconfig.txt
```kconfig
Differences in src/rp2040/Kconfig:

- Lines with differences: 47 lines in 1 blocks

Detailed Differences:

--- /media/mks/5dcae443-0796-4029-ae6c-bf5bd2a37067/home/mks/klipper/src/rp2040/Kconfig	2023-10-20 03:52:19.632163937 -0400
+++ /home/mks/firmware_comparison/downloads/klipper/src/rp2040/Kconfig	2024-10-08 17:45:26.888217467 -0400
@@ -95,19 +95,40 @@
 ######################################################################
 
 choice
-    prompt "Communication interface"
-    config RP2040_USB
-        bool "USB"
-        select USBSERIAL
-    config RP2040_SERIAL_UART0
-        bool "Serial (on UART0 GPIO1/GPIO0)"
-        select SERIAL
-    config RP2040_CANBUS
-        bool "CAN bus"
-        select CANSERIAL
-    config RP2040_USBCANBUS
-        bool "USB to CAN bus bridge"
-        select USBCANBUS
+ prompt "Communication Interface"
+ config RP2040_USB
+     bool "USBSERIAL"
+     select USBSERIAL
+ config RP2040_SERIAL_UART0_PINS_0_1
+      bool "UART0 on GPIO0/GPIO1"
+      select SERIAL
+ config RP2040_SERIAL_UART0_PINS_12_13
+      bool "UART0 on GPIO12/GPIO13" if LOW_LEVEL_OPTIONS
+      select SERIAL
+ config RP2040_SERIAL_UART0_PINS_16_17
+      bool "UART0 on GPIO16/GPIO17" if LOW_LEVEL_OPTIONS
+      select SERIAL
+  config RP2040_SERIAL_UART0_PINS_28_29
+      bool "UART0 on GPIO28/GPIO29" if LOW_LEVEL_OPTIONS
+      select SERIAL
+ config RP2040_SERIAL_UART1_PINS_4_5
+      bool "UART1 on GPIO4/GPIO5" if LOW_LEVEL_OPTIONS
+      select SERIAL
+ config RP2040_SERIAL_UART1_PINS_8_9
+      bool "UART1 on  GPIO8/GPIO9" if LOW_LEVEL_OPTIONS
+      select SERIAL
+ config RP2040_SERIAL_UART1_PINS_20_21
+      bool "UART1 on  GPIO20/GPIO21" if LOW_LEVEL_OPTIONS
+      select SERIAL
+ config RP2040_SERIAL_UART1_PINS_24_25
+      bool "UART1 on GPIO24/GPIO25"  if LOW_LEVEL_OPTIONS
+      select SERIAL
+ config RP2040_CANBUS
+       bool "CAN bus"
+       select CANSERIAL
+ config RP2040_USBCANBUS
+       bool "USB to CAN bus bridge"
+       select USBCANBUS
 endchoice
 
 config RP2040_CANBUS_GPIO_RX
```

## klippercomparison/clean comparisons/klipper/src/stm32/Kconfig.txt
```kconfig
Differences in src/stm32/Kconfig:

- Lines with differences: 29 lines in 8 blocks

Detailed Differences:

--- /media/mks/5dcae443-0796-4029-ae6c-bf5bd2a37067/home/mks/klipper/src/stm32/Kconfig	2023-10-20 03:52:19.644163937 -0400
+++ /home/mks/firmware_comparison/downloads/klipper/src/stm32/Kconfig	2024-10-08 17:45:26.899217508 -0400
@@ -10,7 +10,7 @@
     select HAVE_GPIO_I2C if !MACH_STM32F031
     select HAVE_GPIO_SPI if !MACH_STM32F031
     select HAVE_GPIO_SDIO if MACH_STM32F4
-    select HAVE_GPIO_HARD_PWM if MACH_STM32F1 || MACH_STM32F4 || MACH_STM32F7 || MACH_STM32G0 || MACH_STM32H7
+    select HAVE_GPIO_HARD_PWM if MACH_STM32F070 || MACH_STM32F072 || MACH_STM32F1 || MACH_STM32F4 || MACH_STM32F7 || MACH_STM32G0 || MACH_STM32H7
     select HAVE_STRICT_TIMING
     select HAVE_CHIPID
     select HAVE_STEPPER_BOTH_EDGE
@@ -88,6 +88,9 @@
     config MACH_STM32G431
         bool "STM32G431"
         select MACH_STM32G4
+    config MACH_STM32G474
+        bool "STM32G474"
+        select MACH_STM32G4
     config MACH_STM32H723
         bool "STM32H723"
         select MACH_STM32H7
@@ -181,6 +184,7 @@
     default "stm32g0b0xx" if MACH_STM32G0B0
     default "stm32g0b1xx" if MACH_STM32G0B1
     default "stm32g431xx" if MACH_STM32G431
+    default "stm32g474xx" if MACH_STM32G474
     default "stm32h723xx" if MACH_STM32H723
     default "stm32h743xx" if MACH_STM32H743
     default "stm32h750xx" if MACH_STM32H750
@@ -199,6 +203,7 @@
     default 216000000 if MACH_STM32F765
     default 64000000 if MACH_STM32G0
     default 150000000 if MACH_STM32G431
+    default 170000000 if MACH_STM32G474
     default 400000000 if MACH_STM32H7 # 400Mhz is max Klipper currently supports
     default 80000000 if MACH_STM32L412
     default 64000000 if MACH_N32G45x && STM32_CLOCK_REF_INTERNAL
@@ -206,13 +211,13 @@
 
 config FLASH_SIZE
     hex
-    default 0x4000 if MACH_STM32F031
-    default 0x8000 if MACH_STM32F042
+    default 0x8000 if MACH_STM32F031 || MACH_STM32F042
     default 0x20000 if MACH_STM32F070 || MACH_STM32F072
     default 0x10000 if MACH_STM32F103 || MACH_STM32L412 # Flash size of stm32f103x8 (64KiB)
     default 0x40000 if MACH_STM32F2 || MACH_STM32F401 || MACH_STM32H723
     default 0x80000 if MACH_STM32F4x5 || MACH_STM32F446
     default 0x20000 if MACH_STM32G0 || MACH_STM32G431
+    default 0x40000 if MACH_STM32G474
     default 0x20000 if MACH_STM32H750
     default 0x200000 if MACH_STM32H743 || MACH_STM32F765
     default 0x20000 if MACH_N32G45x
@@ -233,6 +238,7 @@
     default 0x2800 if MACH_STM32F103x6
     default 0x5000 if MACH_STM32F103 && !MACH_STM32F103x6 # Ram size of stm32f103x8
     default 0x8000 if MACH_STM32G431
+    default 0x20000 if MACH_STM32G474
     default 0xa000 if MACH_STM32L412
     default 0x20000 if MACH_STM32F207
     default 0x10000 if MACH_STM32F401
@@ -282,22 +288,24 @@
     config STM32_FLASH_START_8000
         bool "32KiB bootloader" if MACH_STM32F1 || MACH_STM32F2 || MACH_STM32F4 || MACH_STM32F7
     config STM32_FLASH_START_8800
-        bool "34KiB bootloader (Chitu v6 Bootloader)" if MACH_STM32F103
+        bool "34KiB bootloader" if MACH_STM32F103
     config STM32_FLASH_START_20200
-        bool "128KiB bootloader with 512 byte offset (Prusa Buddy)" if MACH_STM32F4x5
+        bool "128KiB bootloader with 512 byte offset" if MACH_STM32F4x5
+    config STM32_FLASH_START_9000
+        bool "36KiB bootloader" if MACH_STM32F1
     config STM32_FLASH_START_C000
-        bool "48KiB bootloader (MKS Robin Nano V3)" if MACH_STM32F4x5
+        bool "48KiB bootloader" if MACH_STM32F4x5 || MACH_STM32F401
     config STM32_FLASH_START_10000
-        bool "64KiB bootloader" if MACH_STM32F103 || MACH_STM32F446 || MACH_STM32F401
+        bool "64KiB bootloader" if MACH_STM32F103 || MACH_STM32F4
 
     config STM32_FLASH_START_800
-        bool "2KiB bootloader (HID Bootloader)" if MACH_STM32F103
+        bool "2KiB bootloader" if MACH_STM32F103
     config STM32_FLASH_START_1000
         bool "4KiB bootloader" if MACH_STM32F1 || MACH_STM32F0
     config STM32_FLASH_START_4000
-        bool "16KiB bootloader (HID Bootloader)" if MACH_STM32F207 || MACH_STM32F401 || MACH_STM32F4x5 || MACH_STM32F103 || MACH_STM32F072
+        bool "16KiB bootloader" if MACH_STM32F207 || MACH_STM32F401 || MACH_STM32F4x5 || MACH_STM32F103 || MACH_STM32F072
     config STM32_FLASH_START_20000
-        bool "128KiB bootloader (SKR SE BX v2.0)" if MACH_STM32H743 || MACH_STM32H723 || MACH_STM32F7
+        bool "128KiB bootloader" if MACH_STM32H743 || MACH_STM32H723 || MACH_STM32F7
 
     config STM32_FLASH_START_0000
         bool "No bootloader"
@@ -312,6 +320,7 @@
     default 0x8007000 if STM32_FLASH_START_7000
     default 0x8008000 if STM32_FLASH_START_8000
     default 0x8008800 if STM32_FLASH_START_8800
+    default 0x8009000 if STM32_FLASH_START_9000
     default 0x800C000 if STM32_FLASH_START_C000
     default 0x8010000 if STM32_FLASH_START_10000
     default 0x8020000 if STM32_FLASH_START_20000
```
